/*
 * Device Tree overlay for the Infineon SLB9670 Trusted Platform Module add-on
 * boards, which can be used as a secure key storage and hwrng.
 * available as "Iridium SLB9670" by Infineon and "LetsTrust TPM" by pi3g.
 */

/dts-v1/;
/plugin/;

/ {
	compatible = "brcm,bcm2835";

	fragment@0 {
		target = <&spi0>;
		__overlay__ {
			compatible = "spi-gpio";
			#address-cells = <1>;
			#size-cells = <0>;
			gpio-sck = <&gpio 11 0>;
			gpio-mosi = <&gpio 10 0>;
			gpio-miso = <&gpio 9 0>;
			cs-gpios = <&gpio 7 1>;
			spi-delay-us = <0>;
			status = "okay";

			slb9670: slb9670@0 {
				compatible = "tcg,tpm_tis-spi";
				#address-cells = <1>;
				#size-cells = <0>;
				reg = <0>;	/* CE1 */
				reset-gpios= <&gpio 24 1>;
				spi-max-frequency = <32000000>;
				status = "okay";
			};
		};
	};
};